## conf/layer.conf
```bitbake
# We have a conf and classes directory, add to BBPATH
BBPATH .= ":${LAYERDIR}"

# We have recipes-* directories, add to BBFILES
BBFILES += "${LAYERDIR}/recipes-*/*/*.bb \
            ${LAYERDIR}/recipes-*/*/*.bbappend"

BBFILE_COLLECTIONS += "meta-openedv"
BBFILE_PATTERN_meta-openedv = "^${LAYERDIR}/"
BBFILE_PRIORITY_meta-openedv = "6"

LAYERDEPENDS_meta-openedv = "core"
LAYERSERIES_COMPAT_meta-openedv = "mickledore"

CORE_IMAGE_EXTRA_INSTALL += "wpa-supplicant hostapd dropbear"
```

## conf/machine/openedv-imx6ull-evk.conf
```bitbake
#@TYPE: Machine
#@NAME: OpenEDV i.MX6ULL Evaluation Kit
#@SOC: i.MX6ULL
#@DESCRIPTION: Machine configuration for OpenEDV i.MX6ULL EVK

MACHINEOVERRIDES =. "mx6ull:"

include conf/machine/include/imx-base.inc
include conf/machine/include/arm/armv7a/tune-cortexa7.inc

MACHINE_FEATURES += "wifi bluetooth"

KERNEL_DEVICETREE = " \
    openedv-imx6ull-evk.dtb \
"

KERNEL_DEVICETREE:append:use-nxp-bsp = " \
"

UBOOT_MAKE_TARGET = "u-boot.imx"
UBOOT_SUFFIX = "imx"

UBOOT_CONFIG ??= " \
    emmc \
    ${@bb.utils.contains('MACHINE_FEATURES', 'optee', 'sd-optee', '', d)} \
"
UBOOT_CONFIG[sd]       = "openedv_imx6ull_evk_config,sdcard"
UBOOT_CONFIG[sd-optee] = "openedv_imx6ull_evk_optee_config,sdcard"
UBOOT_CONFIG[emmc]     = "openedv_imx6ull_evk_config,sdcard"
UBOOT_CONFIG[nand]     = "openedv_imx6ull_evk_nand_config,ubifs"
UBOOT_CONFIG[qspi1]    = "openedv_imx6ull_evk_qspi1_config"
UBOOT_CONFIG[mfgtool]  = "openedv_imx6ull_evk_config"

OPTEE_BIN_EXT = "openedv-imx6ull"
```

## recipes-bsp/u-boot/u-boot-fslc/Kconfig
```kconfig
if TARGET_OPENEDV_IMX6ULL_EVK

config SYS_BOARD
	default "openedv-imx6ull-evk"

config SYS_VENDOR
	default "openedv"

config SYS_CONFIG_NAME
	default "openedv_imx6ull_evk"

config IMX_CONFIG
	default "board/openedv/openedv-imx6ull-evk/imximage.cfg"

endif
```
